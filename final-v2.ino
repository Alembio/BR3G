#include<Servo.h>
#include<math.h>

Servo myServo1;
Servo myServo2;
Servo myServo3;

int L1 = 13;
int L2 = 13;
float ang1, ang2, ang3;
int flag;

double Nm;
double d1 = 0;
double d2 = 0;
double d3 = 0;

double posinit1 = 90;
double posinit2 = 0;
double posinit3 = 0;

float arreglo[] = {
40.658,171.12,138.37,40.222,170.5,137.16,39.623,169.3,134.78,39.032,168.11,132.41,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83.389

};

int S = sizeof(arreglo) / sizeof(arreglo[0]); //Definir el tamaño del arreglo


double deltamayor(double a, double b, double c)
{
  double g = 0;

  if (a < 0)
  {
    a = a * -1;
  }
  if (b < 0)
  {
    b = b * -1;
  }
  if (c < 0)
  {
    c = c * -1;
  }
  if (a > g)
  {
    g = a;
  }
  if (b > g)
  {
    g = b;
  }
  if (c > g)
  {
    g = c;
  }

  return g;
}

double delta(double Nm, double h)
{
  double g;
  g = h / Nm;

  return g;
}

double pos1f = arreglo[0];
double pos2f = arreglo[1];
double pos3f = arreglo[2];

double a = pos1f - posinit1;
double b = pos2f - posinit2;
double c = pos3f - posinit3;

void setup() {

  Serial.begin(9600); //Iniciar comunicación serial

  //Vincular los motores a los pines 9, 10 y 11 del arduino
  myServo1.attach(9);
  myServo2.attach(10);
  myServo3.attach(11);

  //Definir posiciones iniciales
  myServo1.write(90);
  myServo2.write(0);
  myServo3.write(0);

  Serial.println("Escribe 1 para correr el codigo");
}

void loop() {

  if (Serial.available()) { //Si hay comunicación serial

    flag = Serial.read(); //Restricción
  }

  if (flag > 0) //Restricción
  {
    Nm = deltamayor(a, b, c); //Numero de muestras (intervalos) funcion = Nm

    pos1f = posinit1;
    pos2f = posinit2;
    pos3f = posinit3;

    //Abrirse
    for (int i = 0; i <= Nm; i++)
    {
      pos1f = pos1f + d1;
      pos2f = pos2f + d2;
      pos3f = pos3f + d3;
      Serial.print(pos1f);
      Serial.print(" ");
      Serial.print(pos2f);
      Serial.print(" ");
      Serial.print(pos3f);
      Serial.print("\n");
      myServo1.write(pos1f);
      myServo2.write(pos2f);
      myServo3.write(pos3f);
      delay(30);
      d1 = delta(Nm, a); //delta 1
      d2 = delta(Nm, b); //delta 2
      d3 = delta(Nm, c); //delta 3
    }
    delay(3000);
    Serial.println(" ");

    //Puntos
    for (int i = 0; i < S; i = i + 3)
    {
      ang1 = arreglo[i];
      ang2 = arreglo[i + 1];
      ang3 = arreglo[i + 2];

      //Imprimir datos
      Serial.print(ang1);
      Serial.print(" ");
      Serial.print(ang2);
      Serial.print(" ");
      Serial.print(ang3);
      Serial.print("\n");


      myServo1.write(ang1);
      myServo2.write(ang2);
      myServo3.write(ang3);
      delay(75);
    }
    
      posinit1 = ang1;
      posinit2 = ang2;
      posinit3 = ang3;

      pos1f = 90;
      pos2f = 0;
      pos3f = 0;

      a = pos1f - posinit1;
      b = pos2f - posinit2;
      c = pos3f - posinit3;

      Nm = deltamayor(a, b, c); //Numero de muestras (intervalos) funcion = Nm

      pos1f = ang1;
      pos2f = ang2;
      pos3f = ang3;

      d1 = 0;
      d2 = 0;
      d3 = 0;

      delay(3000);
      Serial.println(" ");

      //Guardarse
      for (int i = 0; i <= Nm; i++)
      {
        pos1f = pos1f + d1;
        pos2f = pos2f + d2;
        pos3f = pos3f + d3;
        Serial.print(pos1f);
        Serial.print(" ");
        Serial.print(pos2f);
        Serial.print(" ");
        Serial.print(pos3f);
        Serial.print("\n");
        myServo1.write(pos1f);
        myServo2.write(pos2f);
        myServo3.write(pos3f);
        delay(30);
        d1 = delta(Nm, a); //delta 1
        d2 = delta(Nm, b); //delta 2
        d3 = delta(Nm, c); //delta 3
      }

      Serial.print(90);
      Serial.print(" ");
      Serial.print(0);
      Serial.print(" ");
      Serial.print(0);
      Serial.print("\n");

      myServo1.write(90);
      myServo2.write(0);
      myServo3.write(0);
      delay(30);
    }

    flag = 0; //Restricción
  }

